## CMakeLists.txt
```
# SPDX-License-Identifier: Apache-2.0

cmake_minimum_required(VERSION 3.20.0)
find_package(Zephyr REQUIRED HINTS $ENV{ZEPHYR_BASE})

project(custom_wireless_mouse LANGUAGES C)

target_sources(app PRIVATE src/main.c)
```

## Kconfig
```
# SPDX-License-Identifier: Apache-2.0
#
# Application Kconfig entry point. Browse via `west build -t menuconfig`.

menu "Zephyr"
source "Kconfig.zephyr"
endmenu

module = APP
module-str = APP
source "subsys/logging/Kconfig.template.log_config"
```

## prj.conf
```kconfig
# SPDX-License-Identifier: Apache-2.0
#
# Base application configuration. This is a placeholder — no firmware logic
# exists yet (see src/main.c). Bluetooth/HID/sensor Kconfig options belong
# here once that code is written; nothing is enabled speculatively.

CONFIG_GPIO=y
```

## src/main.c
```c
/* SPDX-License-Identifier: Apache-2.0 */

#include <zephyr/kernel.h>

/*
 * Placeholder entry point. No sensor, BLE HID, or button/encoder handling
 * has been implemented yet — see docs/firmware/ for the current firmware
 * scope and open items.
 */
int main(void)
{
	return 0;
}
```
